## Documentation/devicetree/bindings/display/panel/visionox,vtdr6130.yaml
```yaml
# SPDX-License-Identifier: GPL-2.0-only OR BSD-2-Clause
%YAML 1.2
---
$id: http://devicetree.org/schemas/display/panel/visionox,vtdr6130.yaml#
$schema: http://devicetree.org/meta-schemas/core.yaml#

title: Visionox VTDR6130 AMOLED DSI Panel

maintainers:
  - Neil Armstrong <neil.armstrong@linaro.org>

properties:
  compatible:
    oneOf:
      - const: visionox,vtdr6130
      - description: RetroidPocket panels with the VTDR6130 driver IC
        enum:
          - retroidpocket,rp5-visionox-panel
          - retroidpocket,rp6-panel
          - retroidpocket,rpduo-panel-top
          - retroidpocket,rpflip2-visionox-panel

  reg:
    maxItems: 1
    description: DSI virtual channel

  vddio-supply: true
  vci-supply: true
  vdd-supply: true
  vdd18-supply:
    description: 1.8V supply of the panel module
  vdd28-supply:
    description: 2.8V supply of the panel module
  vdd1v2-supply:
    description: 1.2V supply of the panel module
  avdd-supply:
    description: analog supply of the panel module
  port: true
  reset-gpios: true
  rotation: true

required:
  - compatible
  - reg
  - vddio-supply
  - vdd-supply
  - reset-gpios
  - port

allOf:
  - $ref: panel-common.yaml#
  - if:
      properties:
        compatible:
          contains:
            const: visionox,vtdr6130
    then:
      properties:
        vdd18-supply: false
        vdd28-supply: false
  - if:
      properties:
        compatible:
          contains:
            enum:
              - retroidpocket,rp5-visionox-panel
              - retroidpocket,rpflip2-visionox-panel
    then:
      properties:
        vci-supply: false
        vdd18-supply: false
        vdd28-supply: false
      required:
        - vdd1v2-supply
        - avdd-supply
    else:
      properties:
        vdd1v2-supply: false
        avdd-supply: false
      required:
        - vci-supply

additionalProperties: false

examples:
  - |
    #include <dt-bindings/gpio/gpio.h>
    dsi {
        #address-cells = <1>;
        #size-cells = <0>;
        panel@0 {
            compatible = "visionox,vtdr6130";
            reg = <0>;

            vddio-supply = <&vreg_l12b_1p8>;
            vci-supply = <&vreg_l13b_3p0>;
            vdd-supply = <&vreg_l11b_1p2>;

            reset-gpios = <&tlmm 133 GPIO_ACTIVE_LOW>;

            port {
                panel0_in: endpoint {
                    remote-endpoint = <&dsi0_out>;
                };
            };
        };
    };
...
```

## Documentation/devicetree/bindings/input/ayntec,rsinput.yaml
```yaml
# SPDX-License-Identifier: (GPL-2.0-only OR BSD-2-Clause)
%YAML 1.2
---
$id: http://devicetree.org/schemas/input/ayntec,rsinput.yaml#
$schema: http://devicetree.org/meta-schemas/core.yaml#

title: RSInput UART gamepad controller

maintainers:
  - Teguh Sobirin <teguh@sobir.in>

description:
  Gamepad microcontroller found in AYN and Retroid Pocket handhelds. It is
  attached to a UART running at 115200 baud and reports the buttons, the two
  analog sticks and the two triggers in periodic status frames.

allOf:
  - $ref: /schemas/serial/serial-peripheral-props.yaml#

properties:
  compatible:
    enum:
      - ayntec,rsinput
      - retroidpocket,rsinput

  vdd-supply:
    description: MCU power supply.

  enable-gpios:
    maxItems: 1
    description: GPIO enabling the MCU.

  reset-gpios:
    maxItems: 1
    description: GPIO connected to the MCU reset line.

  boot-gpios:
    maxItems: 1
    description: GPIO selecting the MCU boot mode, driven low for normal boot.

  gamepad-name:
    $ref: /schemas/types.yaml#/definitions/string
    description: Name of the input device.

  gamepad-bus:
    $ref: /schemas/types.yaml#/definitions/uint32
    description: Bus type reported in the input device ID.

  gamepad-vid:
    $ref: /schemas/types.yaml#/definitions/uint32
    description: Vendor ID reported in the input device ID.

  gamepad-pid:
    $ref: /schemas/types.yaml#/definitions/uint32
    description: Product ID reported in the input device ID.

  gamepad-rev:
    $ref: /schemas/types.yaml#/definitions/uint32
    description: Version reported in the input device ID.

  invert-x:
    type: boolean
    description: Invert the left stick X axis.

  invert-y:
    type: boolean
    description: Invert the left stick Y axis.

  invert-rx:
    type: boolean
    description: Invert the right stick X axis.

  invert-ry:
    type: boolean
    description: Invert the right stick Y axis.

  axis-range:
    $ref: /schemas/types.yaml#/definitions/uint32
    default: 0x580
    description:
      Stick travel in raw units. Every stick axis is reported in the range
      -axis-range to +axis-range.

  trigger-left-deadzone:
    $ref: /schemas/types.yaml#/definitions/uint32
    default: 0
    description: Raw left trigger travel reported as released.

  trigger-right-deadzone:
    $ref: /schemas/types.yaml#/definitions/uint32
    default: 0
    description: Raw right trigger travel reported as released.

  digital-triggers:
    type: boolean
    description:
      The triggers are switches. Report them as buttons instead of axes.

  auto-center:
    type: boolean
    description:
      Take the stick positions in the first status frame as the centers,
      for MCUs that report a non-zero position at rest.

  mcu-watchdog:
    type: boolean
    description:
      Probe the MCU link periodically, and reopen the UART and then
      power-cycle the MCU when it stops answering.

required:
  - compatible
  - vdd-supply

unevaluatedProperties: false

examples:
  - |
    #include <dt-bindings/gpio/gpio.h>

    serial {
        gamepad {
            compatible = "ayntec,rsinput";

            gamepad-name = "AYN Odin2 Gamepad";
            gamepad-bus = <0x0003>;
            gamepad-vid = <0x2020>;
            gamepad-pid = <0x3001>;
            gamepad-rev = <0x0001>;

            vdd-supply = <&vdd_mcu_3v3>;
            enable-gpios = <&tlmm 12 GPIO_ACTIVE_HIGH>;

            axis-range = <1024>;
            invert-x;
            invert-y;
            trigger-left-deadzone = <100>;
            trigger-right-deadzone = <100>;
        };
    };
```

## Documentation/devicetree/bindings/regulator/qcom,pmi632-lcdb.yaml
```yaml
# SPDX-License-Identifier: GPL-2.0-only OR BSD-2-Clause
%YAML 1.2
---
$id: http://devicetree.org/schemas/regulator/qcom,pmi632-lcdb.yaml#
$schema: http://devicetree.org/meta-schemas/core.yaml#

title: Qualcomm PMI632 LCDB (LCD Bias) Regulators

maintainers:
  - ROCKNIX <https://github.com/ROCKNIX>

description:
  The LCDB block on the PMI632 PMIC provides the positive (LDO) and negative
  (NCP) bias supplies for LCD panels from a shared boost converter.

properties:
  compatible:
    const: qcom,pmi632-lcdb

  ldo:
    type: object
    $ref: regulator.yaml#
    unevaluatedProperties: false
    description: Positive bias output.

  ncp:
    type: object
    $ref: regulator.yaml#
    unevaluatedProperties: false
    description: Negative bias output, described by its magnitude.

required:
  - compatible

additionalProperties: false

examples:
  - |
    pmic {
        #address-cells = <1>;
        #size-cells = <0>;

        lcdb {
            compatible = "qcom,pmi632-lcdb";

            lcdb_ldo: ldo {
                regulator-name = "lcdb_ldo";
                regulator-min-microvolt = <4000000>;
                regulator-max-microvolt = <6000000>;
            };

            lcdb_ncp: ncp {
                regulator-name = "lcdb_ncp";
                regulator-min-microvolt = <4000000>;
                regulator-max-microvolt = <6000000>;
            };
        };
    };
```

## drivers/input/touchscreen/synaptics_dsx/Kconfig
```kconfig
config TOUCHSCREEN_SYNAPTICS_DSX
	tristate "Synaptics DSX touchscreen"
	depends on I2C
	help
	  Say Y here if you have a Synaptics DSX touchscreen connected
	  to your system via I2C.
```

## drivers/media/platform/qcom/sde-rotator/Kconfig
```kconfig
# SPDX-License-Identifier: GPL-2.0
config VIDEO_QCOM_SDE_ROTATOR
	tristate "Qualcomm SDE mem2mem rotator"
	depends on V4L_MEM2MEM_DRIVERS
	depends on VIDEO_DEV && (ARCH_QCOM || COMPILE_TEST)
	select VIDEOBUF2_DMA_CONTIG
	select V4L2_MEM2MEM_DEV
	help
	  V4L2 mem2mem driver for the standalone SDE rotator block found in
	  the MDSS of Qualcomm SoCs. Provides 90/180/270 rotation
	  and H/V flip of RGB buffers in dedicated hardware,
	  offloading rotation from the GPU.
```
